## firmware/main/Kconfig.projbuild
```kconfig
menu "Lumairie hardware configuration"
    config LUMAIRIE_PAIR_GPIO
        int "Board verified active-low pairing/wake GPIO (-1 disables physical pairing)"
        default -1
        range -1 21
        help
            Set only after board schematic and button circuit are verified.
            Firmware keeps BLE closed when this is -1.
    config LUMAIRIE_ADVERTISE_SECONDS
        int "BLE advertising window after physical button hold"
        default 120
        range 30 600
endmenu
```

## firmware/sdkconfig.defaults
```kconfig
CONFIG_IDF_TARGET="esp32c3"
CONFIG_BT_ENABLED=y
CONFIG_BT_NIMBLE_ENABLED=y
CONFIG_ESP_PROTOCOMM_SUPPORT_SECURITY_VERSION_2=y
CONFIG_BOOTLOADER_APP_ROLLBACK_ENABLE=y
CONFIG_PARTITION_TABLE_CUSTOM=y
CONFIG_PARTITION_TABLE_CUSTOM_FILENAME="partitions.csv"
CONFIG_ESPTOOLPY_FLASHSIZE_8MB=y
```
